/*===========================================================================
 *   FILENAME       : TIMER DRIVER {TimerDrv.C}  
 *   PURPOSE        : Software time handler(timer's ,sysclock ,delay's ...) 
 *   DATE CREATED   : 11/07/2002
 *   PROGRAMMER     : Nir Sade 
 *===========================================================================*/
#include "c8051F020.h"
#include "Define.h"
#include "TimerDrv.h"

// Constants
// =========

#define COUNT_10_MS		0xffff - 0x2400


// Local variables
// ===============
WORD xdata TimerCounter;	
WORD xdata SecondsTimerCounter;	
WORD xdata OneSecondCounter;	
static TIMER_struct xdata TimerStructure;

// Local routines
// ==============
WORD DiffTime(WORD t1,WORD t2);

	

/****************************************************************************
 *
 *  NAME        : Timer_2_Init
 *
 *
 *  DESCRIPTION : Initialization of timer 2.                                        
 *
 ****************************************************************************/
void Timer_2_Init(void)
 {
// stop the timer
// --------------
	TR2 = 0;

// set as timer
// ------------
	CT2 = 0;

// set auto reload mode
// --------------------
	CPRL2 = 0;

// set the value of RCAP2 for a period of 10ms
// -------------------------------------------
	RCAP2L = COUNT_10_MS & LSB_MASK; 
	RCAP2H = (COUNT_10_MS & MSB_MASK) >> 8;

// select the clock supplied to timer 2 as the system clock divided by 12
// ----------------------------------------------------------------------
	CKCON &= 0xdf; 

// set Timer2 to reload immediately
// --------------------------------
	TL2 = 0xff;									  
	TH2 = 0xff;

// disable timer 2 interrupt
// -------------------------
	ET2 = 0;

// start timer 2
// -------------
	TR2 = 1;	

 }


/****************************************************************************
 *
 *  NAME        : Timer_0_Init
 *
 *
 *  DESCRIPTION : Initialization of timer 0.                                        
 *
 ****************************************************************************/
void Timer_0_Init()
{
// disable timer 0
// ---------------
	TR0 = 0;

// reset the timer counter
// -----------------------
	TimerCounter = 0;
    SecondsTimerCounter = 0;
	OneSecondCounter = 0;

// select timer 0 as a 16 bit timer (mode 1) generated by the system clock
// -----------------------------------------------------------------------
  TMOD |= 0x01;
 
// load the timer registers fot a period of 10ms
// ---------------------------------------------
	TL0 = COUNT_10_MS & LSB_MASK;
	TH0 = (COUNT_10_MS & MSB_MASK) >> 8;

// select the clock supplied to timer  as the system clock divided by 12
// ----------------------------------------------------------------------
	CKCON &= 0xf7;  

// enable timer 0 interrupt
// -------------------------
	ET0 = 1;
	
// enable timer 0
// --------------
	TR0 = 1;

}


/****************************************************************************
 *
 *  NAME        : Timer_0_ISR
 *
 *
 *  DESCRIPTION : Interrput service routine of timer 0.                                        
 *
 ****************************************************************************/
void Timer_0_ISR (void) interrupt 1 using 1
{
// clear timer 0 overflow flag
// ---------------------------
	TF0 = 0;

// increment the timer counter
// ---------------------------
	TimerCounter++;

    OneSecondCounter++;

    if (OneSecondCounter >= 100) // Another Second has gone by...
	{ 
	  OneSecondCounter = 0;
	  SecondsTimerCounter++;  //(wrap around)
	}

// load the timer registers fot a period of 10ms
// -------------------------
	TL0 = COUNT_10_MS & LSB_MASK;
	TH0 = (COUNT_10_MS & MSB_MASK) >> 8;
}


/****************************************************************************
 *
 *  NAME        : Timer_4_Init
 *
 *
 *  DESCRIPTION : Initialization of timer 4 as a baud rate generator for UART 1                                       
 *
 ****************************************************************************/
void Timer_4_Init()
{
// Disable timer 4
	T4CON &= 0xFB;

// Select timer 4 as a a baud rate generator (mode 2) 
  T4CON |= 0x30;

// Select timer 4 to be incremented by the system clock
  T4CON &= 0xFD;

// Select the clock supplied to timer as the system clock 
	CKCON |= 0x40;  

// Disable timer 4 interrupt
	EIE2 &= 0xFB;

// Load the timer register for 9600 bps baud rate
  RCAP4H = 0xFF;
	RCAP4L = 0xDC;

// Enable timer 4
 	T4CON |= 0x04;

}


/****************************************************************************
 *
 *  NAME        : SysClkInit
 *
 *
 *  DESCRIPTION : System external clock source initialization.                                        
 *
 ****************************************************************************/
void SysClkInit(void)
{
   int xdata Delay;                              // delay counter

   OSCXCN = 0x67;                          // start external oscillator with
                                           // 18.432MHz crystal
   for (Delay=0; Delay < 256; Delay++);    // XTLVLD blanking interval (>1ms)
   while (!(OSCXCN & 0x80)) ;              // Wait for crystal osc. to settle
   OSCICN = 0x88;                          // select external oscillator as SYSCLK
                                           // source and enable missing clock
                                           // detector



// Set P1.6 as push - pull
  P1MDOUT |= 0x40;

// enable the crossbar
	XBR2 |= 0x40;

// Route the sysclk to a port pin
  XBR1 |= 0x80;
}


/****************************************************************************
 *
 *  NAME        : TimerDelay
 *
 *
 *  DESCRIPTION :                                         
 *
 ****************************************************************************/
void TimerDelay(WORD Delay)
{     

	TIMER_struct xdata DelayTimer;      
	TimerSetTimeout(&DelayTimer ,Delay);
	while	(!TimerHasTimeoutExpired(&DelayTimer))	
		{
		} 

	return;
}

/****************************************************************************
 *
 *  NAME        : TimerDelay
 *
 *
 *  DESCRIPTION : Set timer time out                                        
 *
 ****************************************************************************/
void TimerSetTimeout(TIMER_struct* Timer,WORD Timeout)
{
	
// save start time(counter) and timeout time
// -----------------------------------------
	Timer->StartTime = Timer0GetTimerCounter();

	Timer->Timeout = Timeout;
	
	return;
}

void TimerSEC_SetTimeout(TIMER_struct *Timer,WORD Timeout)
{
// save start time(counter) and timeout time
// -----------------------------------------
	Timer->StartTime = TimerSEC_0GetTimerCounter();

	Timer->Timeout = Timeout;
	
	return;
}

/****************************************************************************
 *
 *  NAME        : TimerTimeoutExpired
 *
 *
 *  DESCRIPTION :                                         
 *
 ****************************************************************************/
BOOL TimerHasTimeoutExpired(TIMER_struct* Timer )
{
	WORD  xdata CurrentTime;

// get the current time
// --------------------
  CurrentTime = Timer0GetTimerCounter();

// check if the timeout has passed
// -------------------------------
	if(DiffTime(Timer->StartTime,CurrentTime) < Timer->Timeout)
 		return  FALSE;

	return  TRUE;
	
}

BOOL TimerSEC_HasTimeoutExpired(TIMER_struct *Timer)
{
	WORD  xdata CurrentTime;

// get the current time
// --------------------
  CurrentTime = TimerSEC_0GetTimerCounter();

// check if the timeout has passed
// -------------------------------
	if(DiffTime(Timer->StartTime,CurrentTime) < Timer->Timeout)
 		return  FALSE;

	return  TRUE;
}

#ifdef DEBUG
/****************************************************************************
 *
 *  NAME        : GetTimerStructPtr
 *
 *
 *  DESCRIPTION : This function return a Ptr to the timer structure                                        
 *
 ****************************************************************************/
TIMER_struct *GetTimerStructPtr(void)
{
  return &TimerStructure;
}
#endif


/****************************************************************************
 *
 *  NAME        : Timer0GetTimerCounter
 *
 *
 *  DESCRIPTION : Returns timer 0 counter                                  
 *
 ****************************************************************************/
WORD Timer0GetTimerCounter()
{
	WORD RetVal;

// disable timer 0 interrupt
// -------------------------
	ET0 = 0;

	RetVal = TimerCounter;

// enable timer 0 interrupt
// -------------------------
	ET0 = 1;

	return RetVal;

}

WORD TimerSEC_0GetTimerCounter()
{
	WORD RetVal;

// disable timer 0 interrupt
// -------------------------
	ET0 = 0;

	RetVal = SecondsTimerCounter;

// enable timer 0 interrupt
// -------------------------
	ET0 = 1;

	return RetVal;
}


/****************************************************************************
 *
 *  NAME        : DiffTime
 *
 *
 *  DESCRIPTION : Returns the difference between t2 to t1 
 *								(taking wrap-around in a account)                                  
 *
 ****************************************************************************/
WORD DiffTime(WORD t1,WORD t2)
{
  if(t2 > t1)
    return (t2 - t1);

  return ((0xffff - t1) + t2 + 1);
}
