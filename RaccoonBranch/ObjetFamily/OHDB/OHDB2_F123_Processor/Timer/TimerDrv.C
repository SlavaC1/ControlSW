/*===========================================================================
 *   FILENAME       : TIMER DRIVER {TimerDrv.C}  
 *   PURPOSE        : Software time handler(timer's ,sysclock ,delay's ...) 
 *   DATE CREATED   : 11/07/2002
 *   PROGRAMMER     : Nir Sade 
 *===========================================================================*/
 
#include "c8051F120.h"
#define TL2 TMR2L
#define TH2 TMR2H	
#define T4CON TMR4CN

#include "Define.h"
#include "TimerDrv.h"
#include "ActuatorsOHDB.h"

// Constants
// =========

#define COUNT_10_MS		0xffff - 0x2400
#define SYSCLK        		   11059200    // Oscillator Frequency 
#define BAUDRATE        		   9600    // Baudrate init value 


// Local variables
// ===============
WORD xdata TimerCounter;	
static  xdata TIMER_struct  TimerStructure;

// Local routines
// ==============
WORD DiffTime(WORD t1,WORD t2);

	

/****************************************************************************
 *
 *  NAME        : Timer_2_Init
 *
 *
 *  DESCRIPTION : Initialization of timer 2.                                        
 *
 ****************************************************************************/
void Timer_2_Init(void)
 {
	SFRPAGE = TMR2_PAGE;

// stop the timer
// --------------
	TR2 = 0;

// set as timer
// ------------
	CT2 = 0;

// set auto reload mode
// --------------------
	TMR2CN &= 0xFE;

// set the value of RCAP2 for a period of 10ms
// -------------------------------------------
	RCAP2L = COUNT_10_MS & LSB_MASK; 
	RCAP2H = (COUNT_10_MS & MSB_MASK) >> 8;

// select the clock supplied to timer 2 as the system clock divided by 12
// ----------------------------------------------------------------------	
	TMR2CF &= 0xE7; 

// set Timer2 to reload immediately
// --------------------------------
	TL2 = 0xff;									  
	TH2 = 0xff;

// disable timer 2 interrupt
// -------------------------
	ET2 = 0;

// start timer 2
// -------------
	TR2 = 1;
 }


/****************************************************************************
 *
 *  NAME        : Timer_0_Init
 *
 *
 *  DESCRIPTION : Initialization of timer 0.                                        
 *
 ****************************************************************************/
void Timer_0_Init()
{
	SFRPAGE = TIMER01_PAGE;

// disable timer 0
// ---------------
	TR0 = 0;

// reset the timer counter
// -----------------------
	TimerCounter = 0;

// select timer 0 as a 16 bit timer (mode 1) generated by the system clock
// -----------------------------------------------------------------------
    TMOD |= 0x01;
 
// load the timer registers fot a period of 10ms
// ---------------------------------------------
	TL0 = COUNT_10_MS & LSB_MASK;
	TH0 = (COUNT_10_MS & MSB_MASK) >> 8;

// select the clock supplied to timer  as the system clock divided by 12
// ----------------------------------------------------------------------
	CKCON &= 0xF4;  // Reset bits SCA0 and SCA1 -> System clock divide by 12.
	                // Reset bit T0M -> Use the prescaled clock.  

// enable timer 0 interrupt
// -------------------------
	ET0 = 1;
	
// enable timer 0
// --------------
	TR0 = 1;
}


/****************************************************************************
 *
 *  NAME        : Timer_0_ISR
 *
 *
 *  DESCRIPTION : Interrput service routine of timer 0.                                        
 *
 ****************************************************************************/
void Timer_0_ISR (void) interrupt 1
{
// clear timer 0 overflow flag
// ---------------------------
	TF0 = 0;

// increment the timer counter
// ---------------------------
	TimerCounter++;

// load the timer registers fot a period of 10ms
// -------------------------
	TL0 = COUNT_10_MS & LSB_MASK;
	TH0 = (COUNT_10_MS & MSB_MASK) >> 8;
}

/****************************************************************************
 *
 *  NAME        : Timer_1_Init - Implementation for F120 CPU
 *
 *
 *  DESCRIPTION : Initialization of timer 1 as a baud rate generator for UART 1                                       
 *
 ****************************************************************************/

void Timer_1_Init()
{
	SFRPAGE = TIMER01_PAGE;

// TMOD: timer 1, mode 2, 8-bit auto-reload
	TMOD  |= 0x20;                                 
	TMOD  &= 0xEF;

    TH1        = 0xD0; // Set Timer1 reload value for baudrate
    CKCON     &= 0xEF; // Reset bit T1M: Timer 1 uses the clock defined by the prescale bits, SCA1–SCA0, as time base.
	CKCON     &= 0xF4; // Reset bits SCA0 and SCA1 -> SYSCLK divide by 12.
	TR1        = SET;  // TR1:  timer 1 run
	TCON      |= 0x40; // Set timer 1 ON
}

/****************************************************************************
 *
 *  NAME        : Timer_4_Init - Implementation for F120 CPU
 *
 *
 *  DESCRIPTION : Initialization of timer 4 as a baud rate generator for UART 0                                       
 *
 ****************************************************************************/

void Timer_4_Init()
{
	SFRPAGE = TMR4_PAGE;
	
	// Disable timer 4
	TMR4CN &= 0xFB;
	
	// Timer4 uses SYSCLK as time base. // Note: Equivalent to the F020's 	CKCON |= 0x40;   // Timer4 uses SYSCLK as time base 
	TMR4CF = 0x08;	  
	
	// Select timer 4 to be incremented by the system clock
	TMR4CN &= 0xFD; // Note: see complimentary configutation of register TMR4CF 
	
	// Note: In the F120, setting timer 4 as a a baud rate generator for UART0 is done via the SSTA0 register, implemented in the UART0 initialization function.
	// Disable timer 4 interrupt
	EIE2 &= 0xFB;
	
	// Load the timer register for 9600 bps baud rate
	RCAP4H = 0xFF;
	RCAP4L = 0xB8;
	
	// Enable timer 4
	TMR4CN |= 0x04;
}

/****************************************************************************
 *
 *  NAME        : Timer_0_ISR
 *
 *
 *  DESCRIPTION : Interrput service routine of timer 0.                                        
 *
 ****************************************************************************/
void Timer_4_ISR (void) interrupt 16 using 1
{
}


/****************************************************************************
 *
 *  NAME        : SysClkInit
 *
 *
 *  DESCRIPTION : System external clock source initialization.                                        
 *
 ****************************************************************************/
void SysClkInit(void)
{
   int xdata Delay;        // delay counter

   SFRPAGE = CONFIG_PAGE;  // Switch to CONFIG_PAGE page, for regs: CLKSEL, OSCXCN, OSCICN, P1MDOUT and XBR

   OSCXCN = 0x67;                          // start external oscillator with
                                           // 18.432MHz crystal


   for (Delay=0; Delay < 256; Delay++);    // XTLVLD blanking interval (>1ms)  
   CLKSEL |= 0x01;  					   // Select the external clock;
   OSCICN &= ~0x80;                        // select external oscillator as SYSCLK
                                           // source and enable missing clock detector

// Set P2.4 as push - pull
// -----------------------
   P2MDOUT |= 0x10;

   SFRPAGE = LEGACY_PAGE;
}


/****************************************************************************
 *
 *  NAME        : TimerDelay
 *
 *
 *  DESCRIPTION :                                         
 *
 ****************************************************************************/
void TimerDelay(WORD Delay)
{     

	xdata TIMER_struct	DelayTimer;      
	TimerSetTimeout(&DelayTimer ,Delay);
	while	(TimerTimeoutExpired(&DelayTimer) != TIMEOUT_EXPIRED)	
		{
		} 

	return;
}

/****************************************************************************
 *
 *  NAME        : TimerDelay
 *
 *
 *  DESCRIPTION : Set timer time out                                        
 *
 ****************************************************************************/
void TimerSetTimeout(TIMER_struct* Timer,WORD Timeout)
{
	
// save start time(counter) and timeout time
// -----------------------------------------
	Timer->StartTime = Timer0GetTimerCounter();

	Timer->Timeout = Timeout;
	
	return;
}

/****************************************************************************
 *
 *  NAME        : TimerTimeoutExpired
 *
 *
 *  DESCRIPTION :                                         
 *
 ****************************************************************************/
char TimerTimeoutExpired(TIMER_struct* Timer )
{
	WORD  xdata CurrentTime;

// get the current time
// --------------------
  CurrentTime = Timer0GetTimerCounter();

// check if the timeout has passed
// -------------------------------
	if(DiffTime(Timer->StartTime,CurrentTime) < Timer->Timeout)
 		return  TIMEOUT_NOT_EXPIRED;

	return  TIMEOUT_EXPIRED;
	
}

/****************************************************************************
 *
 *  NAME        : GetTimerStructPtr
 *
 *
 *  DESCRIPTION : This function return a Ptr to the timer structure                                        
 *
 ****************************************************************************/
TIMER_struct *GetTimerStructPtr(void)
{
  return &TimerStructure;
}



/****************************************************************************
 *
 *  NAME        : Timer0GetTimerCounter
 *
 *
 *  DESCRIPTION : Returns timer 0 counter                                  
 *
 ****************************************************************************/
WORD Timer0GetTimerCounter()
{
	WORD RetVal;

// disable timer 0 interrupt
// -------------------------
	ET0 = 0;

	RetVal = TimerCounter;

// enable timer 0 interrupt
// -------------------------
	ET0 = 1;

	return RetVal;

}


/****************************************************************************
 *
 *  NAME        : DiffTime
 *
 *
 *  DESCRIPTION : Returns the difference between t2 to t1 
 *								(taking wrap-around in a account)                                  
 *
 ****************************************************************************/
WORD DiffTime(WORD t1,WORD t2)
{
  if(t2 > t1)
    return (t2 - t1);

  return ((0xffff - t1) + t2 + 1);
}
