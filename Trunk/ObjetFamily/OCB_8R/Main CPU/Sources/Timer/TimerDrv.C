/*===========================================================================
 *   FILENAME       : TIMER DRIVER {TimerDrv.C}  
 *   PURPOSE        : Software time handler(timer's ,sysclock ,delay's ...) 
 *   DATE CREATED   : 11/07/2002
 *   PROGRAMMER     : Nir Sade 
 *===========================================================================*/
#ifdef OCB2
#include "c8051F120.h"
#define TL2 TMR2L
#define TH2 TMR2H
#define T4CON TMR4CN
#else
#include "c8051F020.h"
#endif
#include "Define.h"
#include "TimerDrv.h"

// Constants
// =========

#define COUNT_10_MS		0xffff - 0x2400
#define SYSCLK        		   11059200    // Oscillator Frequency 
#define BAUDRATE        		   9600    // Baudrate init value 


// Local variables
// ===============
WORD xdata TimerCounter;	
WORD xdata SecondsTimerCounter;	
WORD xdata OneSecondCounter;	
static TIMER_struct xdata TimerStructure;

// Local routines
// ==============
WORD DiffTime(WORD t1,WORD t2);

	

/****************************************************************************
 *
 *  NAME        : Timer_2_Init
 *
 *
 *  DESCRIPTION : Initialization of timer 2.
 *
 *
 *  NOTE        : Timer 2 is used by ADC0 (Analog to digital conversion)
 *	              A timer overflow initiates an ADC conversion.
 *
 ****************************************************************************/
void Timer_2_Init(void)
 {

#ifdef OCB2
	SFRPAGE = TMR2_PAGE;
#endif

// stop the timer
// --------------
	TR2 = 0;

// set as timer
// ------------
	CT2 = 0;

// set auto reload mode
// --------------------
#ifdef OCB2
	TMR2CN &= 0xFE;
#else
	CPRL2 = 0;
#endif

// set the value of RCAP2 for a period of 10ms
// -------------------------------------------
	RCAP2L = COUNT_10_MS & LSB_MASK; 
	RCAP2H = (COUNT_10_MS & MSB_MASK) >> 8;

// select the clock supplied to timer 2 as the system clock divided by 12
// ----------------------------------------------------------------------
#ifdef OCB2	
	TMR2CF &= 0xE7;
#else
	CKCON  &= 0xdf; 
#endif
    

// set Timer2 to reload immediately
// --------------------------------
#ifdef OCB2
	TMR2L = 0xff;									  
	TMR2H = 0xff;
#else
	TL2 = 0xff;									  
	TH2 = 0xff;
#endif
// disable timer 2 interrupt
// -------------------------
	ET2 = 0;

// start timer 2
// -------------
	TR2 = 1;	

 }


/****************************************************************************
 *
 *  NAME        : Timer_0_Init
 *
 *
 *  DESCRIPTION : Initialization of timer 0.  
 *                Timer 0 serves as a general purpose 10ms timer available for software routines.
 *
 ****************************************************************************/
void Timer_0_Init()
{
#ifdef OCB2
	SFRPAGE = TIMER01_PAGE;
#endif

// disable timer 0
// ---------------
	TR0 = 0;

// reset the timer counter
// -----------------------
	TimerCounter = 0;
    SecondsTimerCounter = 0;
	OneSecondCounter = 0;

// select timer 0 as a 16 bit timer (mode 1) generated by the system clock
// -----------------------------------------------------------------------
  TMOD |= 0x01;
 
// load the timer registers fot a period of 10ms
// ---------------------------------------------
	TL0 = COUNT_10_MS & LSB_MASK;
	TH0 = (COUNT_10_MS & MSB_MASK) >> 8;

// select the clock supplied to timer  as the system clock divided by 12
// ----------------------------------------------------------------------
#ifdef OCB2
	CKCON &= 0xF4;  // Reset bits SCA0 and SCA1 -> System clock divide by 12.
	                // Reset bit T0M -> Use the prescaled clock.
#else
	CKCON &= 0xf7;  
#endif

// enable timer 0 interrupt
// -------------------------
	ET0 = 1;
	
// enable timer 0
// --------------
	TR0 = 1;

}


/****************************************************************************
 *
 *  NAME        : Timer_0_ISR
 *
 *
 *  DESCRIPTION : Interrput service routine of timer 0.                                        
 *
 ****************************************************************************/
void Timer_0_ISR (void) interrupt 1 using 1
{
// clear timer 0 overflow flag
// ---------------------------
	TF0 = 0;

// increment the timer counter
// ---------------------------
	TimerCounter++;

    OneSecondCounter++;

    if (OneSecondCounter >= 100) // Another Second has gone by...
	{ 
	  OneSecondCounter = 0;
	  SecondsTimerCounter++;  //(wrap around)
	}

// load the timer registers fot a period of 10ms
// -------------------------
	TL0 = COUNT_10_MS & LSB_MASK;
	TH0 = (COUNT_10_MS & MSB_MASK) >> 8;
}

/****************************************************************************
 *
 *  NAME        : Timer_1_Init - Implementation for OCB2 (F120 CPU)
 *
 *
 *  DESCRIPTION : Initialization of timer 1 as a baud rate generator for UART 1                                       
 *
 ****************************************************************************/
#ifdef OCB2
void Timer_1_Init()
{
	SFRPAGE = TIMER01_PAGE;

// TMOD: timer 1, mode 2, 8-bit auto-reload
	TMOD  |= 0x20;                                 
	TMOD  &= 0xEF;

    TH1        = 0xD0; // Set Timer1 reload value for baudrate
    CKCON     &= 0xEF; // Reset bit T1M: Timer 1 uses the clock defined by the prescale bits, SCA1–SCA0, as time base.
	CKCON     &= 0xF4; // Reset bits SCA0 and SCA1 -> SYSCLK divide by 12.
	TR1        = SET;  // TR1:  timer 1 run
	TCON      |= 0x40; // Set timer 1 ON
}
#endif


/****************************************************************************
 *
 *  NAME        : Timer_1_Init - Implementation for OCB1 (F020 CPU)
 *
 *
 *  DESCRIPTION : Initialization of timer 1 as a baud rate generator for UART 0                                       
 *
 ****************************************************************************/
#ifndef OCB2
void Timer_1_Init()
{
  TMOD          |= 0x20;                     // TMOD: timer 1, mode 2, 8-bit reload
  TH1            = -(SYSCLK/BAUDRATE/16);    // set Timer1 reload value for baudrate
  CKCON         |= 0x10;                     // Timer1 uses SYSCLK as time base
  TR1            = SET;                      // TR1:  timer 1 run
  TCON          |= 0x40;                     // Set timer 1 ON
}
#endif

/****************************************************************************
 *
 *  NAME        : Timer_4_Init - Implementation for OCB2 (F120 CPU)
 *
 *
 *  DESCRIPTION : Initialization of timer 4 as a baud rate generator for UART 0                                       
 *
 ****************************************************************************/
#ifdef OCB2
void Timer_4_Init()
{
  SFRPAGE = TMR4_PAGE;

// Disable timer 4
  TMR4CN &= 0xFB;

// Timer4 uses SYSCLK as time base. // Note: Equivalent to the F020's 	CKCON |= 0x40;   // Timer4 uses SYSCLK as time base 
  TMR4CF = 0x08;	  

// Select timer 4 to be incremented by the system clock
  TMR4CN &= 0xFD; // Note: see complimentary configutation of register TMR4CF 

// Note: In the F120, setting timer 4 as a a baud rate generator for UART0 is done via the SSTA0 register, implemented in the UART0 initialization function.
// Disable timer 4 interrupt
  EIE2 &= 0xFB;

// Load the timer register for 9600 bps baud rate
  RCAP4H = 0xFF;
  RCAP4L = 0xB8;

// Enable timer 4
  TMR4CN |= 0x04;
}
#endif

/****************************************************************************
 *
 *  NAME        : Timer_4_Init - Implementation for OCB1 (F020 CPU)
 *
 *
 *  DESCRIPTION : Initialization of timer 4 as a baud rate generator for UART 1                                       
 *
 ****************************************************************************/
#ifndef OCB2
void Timer_4_Init()
{
// Disable timer 4
	T4CON &= 0xFB;

// Select timer 4 as a a baud rate generator (mode 2) 
  T4CON |= 0x30;

// Select timer 4 to be incremented by the system clock
  T4CON &= 0xFD;

// Select the clock supplied to timer as the system clock 
	CKCON |= 0x40;  

// Disable timer 4 interrupt
	EIE2 &= 0xFB;

// Load the timer register for 9600 bps baud rate
  RCAP4H = 0xFF;
	RCAP4L = 0xDC;

// Enable timer 4
 	T4CON |= 0x04;
}
#endif

/****************************************************************************
 *
 *  NAME        : SysClkInit
 *
 *
 *  DESCRIPTION : System external clock source initialization.                                        
 *
 ****************************************************************************/
void SysClkInit(void)
{
   int Delay;                              // delay counter

#ifdef OCB2
   SFRPAGE = CONFIG_PAGE;  // Switch to CONFIG_PAGE page, for regs: CLKSEL, OSCXCN, OSCICN, P1MDOUT and XBR
#endif 

   OSCXCN = 0x67;                          // start external oscillator with
                                           // 18.432MHz crystal

#ifdef OCB2
   for (Delay=0; Delay < 256; Delay++);    // XTLVLD blanking interval (>1ms)  
   CLKSEL |= 0x01;  					   // Select the external clock;
   OSCICN &= ~0x80;                        // select external oscillator as SYSCLK
                                           // source and enable missing clock detector
			    
#else
   for (Delay=0; Delay < 256; Delay++);    
   while (!(OSCXCN & 0x80)) ;              
   OSCICN = 0x88;                          
                                           
#endif

// Set P1.6 as push - pull
  P1MDOUT |= 0x40;

// enable the crossbar
  XBR2 |= 0x40;

// Route the sysclk to a port pin
//     - In OCB2, only the CLKSEL SFR can be configured to pre-devide the sysclk before it is output to a port pin, but the default is not to devide.
  XBR1 |= 0x80;

#ifdef OCB2
   SFRPAGE = LEGACY_PAGE;
#endif 
}


/****************************************************************************
 *
 *  NAME        : TimerDelay
 *
 *
 *  DESCRIPTION :                                         
 *
 ****************************************************************************/
void TimerDelay(WORD Delay)
{     

	TIMER_struct xdata DelayTimer;      
	TimerSetTimeout(&DelayTimer ,Delay);
	while	(!TimerHasTimeoutExpired(&DelayTimer))	
		{
		} 

	return;
}

/****************************************************************************
 *
 *  NAME        : TimerDelay
 *
 *
 *  DESCRIPTION : Set timer time out                                        
 *
 ****************************************************************************/
void TimerSetTimeout(TIMER_struct* Timer,WORD Timeout)
{
	
// save start time(counter) and timeout time
// -----------------------------------------
	Timer->StartTime = Timer0GetTimerCounter();

	Timer->Timeout = Timeout;
	
	return;
}

void TimerSEC_SetTimeout(TIMER_struct *Timer,WORD Timeout)
{
// save start time(counter) and timeout time
// -----------------------------------------
	Timer->StartTime = TimerSEC_0GetTimerCounter();

	Timer->Timeout = Timeout;
	
	return;
}

/****************************************************************************
 *
 *  NAME        : TimerTimeoutExpired
 *
 *
 *  DESCRIPTION :                                         
 *
 ****************************************************************************/
BOOL TimerHasTimeoutExpired(TIMER_struct* Timer )
{
	WORD  xdata CurrentTime;

// get the current time
// --------------------
  CurrentTime = Timer0GetTimerCounter();

// check if the timeout has passed
// -------------------------------
	if(DiffTime(Timer->StartTime,CurrentTime) < Timer->Timeout)
 		return  FALSE;

	return  TRUE;
	
}

BOOL TimerSEC_HasTimeoutExpired(TIMER_struct *Timer)
{
	WORD  xdata CurrentTime;

// get the current time
// --------------------
  CurrentTime = TimerSEC_0GetTimerCounter();

// check if the timeout has passed
// -------------------------------
	if(DiffTime(Timer->StartTime,CurrentTime) < Timer->Timeout)
 		return  FALSE;

	return  TRUE;
}

#ifdef DEBUG
/****************************************************************************
 *
 *  NAME        : GetTimerStructPtr
 *
 *
 *  DESCRIPTION : This function return a Ptr to the timer structure                                        
 *
 ****************************************************************************/
TIMER_struct *GetTimerStructPtr(void)
{
  return &TimerStructure;
}
#endif


/****************************************************************************
 *
 *  NAME        : Timer0GetTimerCounter
 *
 *
 *  DESCRIPTION : Returns timer 0 counter                                  
 *
 ****************************************************************************/
WORD Timer0GetTimerCounter()
{
	WORD RetVal;

// disable timer 0 interrupt
// -------------------------
	ET0 = 0;

	RetVal = TimerCounter;

// enable timer 0 interrupt
// -------------------------
	ET0 = 1;

	return RetVal;

}

WORD TimerSEC_0GetTimerCounter()
{
	WORD RetVal;

// disable timer 0 interrupt
// -------------------------
	ET0 = 0;

	RetVal = SecondsTimerCounter;

// enable timer 0 interrupt
// -------------------------
	ET0 = 1;

	return RetVal;
}


/****************************************************************************
 *
 *  NAME        : DiffTime
 *
 *
 *  DESCRIPTION : Returns the difference between t2 to t1 
 *								(taking wrap-around in a account)                                  
 *
 ****************************************************************************/
WORD DiffTime(WORD t1,WORD t2)
{
  if(t2 > t1)
    return (t2 - t1);

  return ((0xffff - t1) + t2 + 1);
}
