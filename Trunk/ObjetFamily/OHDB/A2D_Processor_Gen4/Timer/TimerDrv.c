/*===========================================================================
 *   FILENAME       : TIMER DRIVER {TimerDrv.C}  
 *   PURPOSE        : Software time handler(timer's ,sysclock ,delay's ...) 
 *   DATE CREATED   : 09/Sep/2001
 *   PROGRAMMER     : Juval Izhaki 
 *   PROCEDURES     : Timer_1_Init(),Timer_2_Init(),Timer_3_Init(),Timer_1_ISR()  
 *                    Timer_2_ISR(),Timer_2_ISR(),SysClkInit()     
 *   Description    : This file hold's all timer routine,init the timers and 
 *                    handel there interupt service routine  
 *   Include        : TimerDrv.h 
 *===========================================================================*/
#include "c8051F200.h"
#include "Define.h"
#include "TimerDrv.h"
// Compiler Definitions
// Done automaticly Writen in the prg file 
// ====================


// Procedure Specifications 
// ========================


// Local declerations
// ==================

// Constants
// =========

// Type definitions
// ================
#define TC_100ms	          100                // approx number of counts of 12 MHz/12
#define TIMER_MAX_VAL         32761              // Timer maximum value to reload   
#define TIMER_MAXTIMER        65535
#define TIME_OUT_TO_LARGE     -1
#define TIMER_OK               1


#define COUNT_1_MS		0xffff - 0x399
#define COUNT_10_MS		0xffff - 0x2400
// Array definitions
// =================

// Macros
// ======

// Local variables
// ===============
	WORD xdata TimerCounter;	
	static  xdata TIMER_struct  TimerStructure;
// Local routines
// ==============
	
	WORD DiffTime(WORD t1,WORD t2);

	
// Exported routines
// =================

/*===========================================================================
 *   FILENAME       : TIMER DRIVER {TimerDrv.C}  
 *   PURPOSE        : Software time handler(timer's ,sysclock ,delay's ...) 
 *   DATE CREATED   : 16/Sep/2001
 *   PROGRAMMER     : Juval Izhaki 
 *   Procedure Name : Timer_2_Init()
 *   Description    : Init the hardware TIMER 2  
 *   Input          : None
 *   Return         : None
 *===========================================================================*/
void Timer_2_Init(void)
 {
// stop the timer
// --------------
	TR2 = 0;

// set as timer
// ------------
	CT2 = 0;

// set auto reload mode
// --------------------
	CPRL2 = 0;

// set the value of RCAP2 for a period of 10ms
// -------------------------------------------
	RCAP2L = COUNT_1_MS & LSB_MASK; 
	RCAP2H = (COUNT_1_MS & MSB_MASK) >> 8;

// set Timer2 to reload immediately
// --------------------------------
	TL2 = 0xff;									  
	TH2 = 0xff;

// disable timer 2 interrupt

// start timer 2
// -------------
	TR2 = 1;	

 }//End of  Timer_2_Init()


/****************************************************************************
 *
 *  NAME        : Timer_0_Init
 *
 *
 *  DESCRIPTION : Initialization of timer 0.                                        
 *
 ****************************************************************************/
void Timer_0_Init()
{
// disable timer 0
// ---------------
	TR0 = 0;

// reset the timer counter
// -----------------------
	TimerCounter = 0;

// select timer 0 as a 16 bit timer (mode 0) generated by the system clock
// -----------------------------------------------------------------------
  TMOD |= 0x01;
 
// load the timer registers fot a period of 10ms
// -------------------------
	TL0 = COUNT_10_MS & LSB_MASK;
	TH0 = (COUNT_10_MS & MSB_MASK) >> 8;

// select the clock supplied to timer 2 as the system clock divided by 12
// ---------------------------------------------------------------------- 

// enable timer 0 interrupt
// -------------------------
	ET0 = 1;
	
// enable timer 0
// --------------
	TR0 = 1;

}


/****************************************************************************
 *
 *  NAME        : Timer_0_ISR
 *
 *
 *  DESCRIPTION : Interrput service routine of timer 0.                                        
 *
 ****************************************************************************/
void Timer_0_ISR (void) interrupt 1
{
// clear timer 0 overflow flag
// ---------------------------
	TF0 = 0;

// increment the timer counter
// ---------------------------
	TimerCounter++;

// load the timer registers fot a period of 10ms
// -------------------------
	TL0 = COUNT_10_MS & LSB_MASK;
	TH0 = (COUNT_10_MS & MSB_MASK) >> 8;


}

/*===========================================================================
 *   FILENAME       : TIMER DRIVER {TimerDrv.C}  
 *   PURPOSE        : Software time handler(timer's ,sysclock ,delay's ...) 
 *   DATE CREATED   : 09/Sep/2001
 *   PROGRAMMER     : Juval Izhaki 
 *   Procedure Name : void SysClkInit(void)
 *   Description    : System external clock source init   
 *   Input          : None
 *   Return         : None
 *===========================================================================*/
void SysClkInit(void)
{
   int xdata Delay;                              // delay counter

   OSCXCN = 0x67;                          // start external oscillator with
                                           // 18.432MHz crystal
   for (Delay=0; Delay < 256; Delay++);    // XTLVLD blanking interval (>1ms)
   while (!(OSCXCN & 0x80)) ;              // Wait for crystal osc. to settle
   OSCICN = 0x88;                          // select external oscillator as SYSCLK
                                           // source and enable missing clock
                                           // detector
}

/*===========================================================================
 *   FILENAME       : TIMER DRIVER {TimerDrv.C}  
 *   PURPOSE        : Software time handler(timer's ,sysclock ,delay's ...) 
 *   DATE CREATED   : 16/Sep/2001
 *   PROGRAMMER     : Juval Izhaki 
 *   Procedure Name : char TimerDelay(int Delay)
 *   Description    : Delay in system cycles by input   
 *   Input          : int Delay
 *   Return         : char status 
 *===========================================================================*/
BYTE TimerDelay(WORD Delay)
{     

	xdata TIMER_struct	DelayTimer;      
	TimerSetTimeout(&DelayTimer ,Delay);
	while	(TimerTimeoutExpired(&DelayTimer) != TIMEOUT_EXPIRED)	
		{
		} 

	return TIMER_OK;
}

/*===========================================================================
 *   FILENAME       : TIMER DRIVER {TimerDrv.C}  
 *   PURPOSE        : Software time handler(timer's ,sysclock ,delay's ...) 
 *   DATE CREATED   : 16/Sep/2001
 *   PROGRAMMER     : Juval Izhaki 
 *   Procedure Name : TimerSetTimeout()
 *   Description    : Set timer time out 
 *   Input          : Timeout time in milliseconds
 *   Return         : char status 
 *===========================================================================*/
char TimerSetTimeout(TIMER_struct* Timer,WORD Timeout)
{
	
// save start time(counter) and timeout time
// -----------------------------------------
	Timer->StartTime = Timer0GetTimerCounter();

	Timer->Timeout = Timeout;
	
	return TIMER_OK;
}
/*===========================================================================
 *   FILENAME       : TIMER DRIVER {TimerDrv.C}  
 *   PURPOSE        : Software time handler(timer's ,sysclock ,delay's ...) 
 *   DATE CREATED   : 16/Sep/2001
 *   PROGRAMMER     : Juval Izhaki 
 *   Procedure Name : TimerTimeoutExpired()
 *   Description    : Check if timer time out Expired 
 *   Input          : Timer struct 
 *   Return         : char status 
 *===========================================================================*/

char TimerTimeoutExpired(TIMER_struct* Timer )
{
	WORD  xdata CurrentTime;

// get the current time
// --------------------
  CurrentTime = Timer0GetTimerCounter();

// check if the timeout has passed
// -------------------------------
	if(DiffTime(Timer->StartTime,CurrentTime) < Timer->Timeout)
 		return  TIMEOUT_NOT_EXPIRED;

	return  TIMEOUT_EXPIRED;
	
}//EOF
/*===========================================================================
 *   FILENAME       : TIMER DRIVER {TimerDrv.C}  
 *   PURPOSE        : Software time handler(timer's ,sysclock ,delay's ...) 
 *   DATE CREATED   : 16/Sep/2001
 *   PROGRAMMER     : Juval Izhaki 
 *   Procedure Name : GetTimerStructPtr();
 *   Description    : This function return a Ptr to the timer structure 
 *   Input          : Timer struct 
 *   Return         : Ptr to timer structure  
 *===========================================================================*/
TIMER_struct *GetTimerStructPtr(void)
{
  return &TimerStructure;
}



/****************************************************************************
 *
 *  NAME        : Timer0GetTimerCounter
 *
 *
 *  DESCRIPTION : Returns timer 0 counter                                  
 *
 ****************************************************************************/
WORD Timer0GetTimerCounter()
{
	WORD RetVal;

// disable timer 0 interrupt
// -------------------------
	ET0 = 0;

	RetVal = TimerCounter;

// enable timer 0 interrupt
// -------------------------
	ET0 = 1;

	return RetVal;

}


/****************************************************************************
 *
 *  NAME        : DiffTime
 *
 *
 *  DESCRIPTION : Returns the difference between t2 to t1 
 *								(taking wrap-around in a account)                                  
 *
 ****************************************************************************/
WORD DiffTime(WORD t1,WORD t2)
{
  if(t2 > t1)
    return (t2 - t1);

  return ((0xffff - t1) + t2 + 1);
}
